## CMakeLists.txt
```
# SPDX-License-Identifier: Apache-2.0

cmake_minimum_required(VERSION 3.20.0)
find_package(Zephyr REQUIRED HINTS $ENV{ZEPHYR_BASE})
project(tuff-tuff-light-central)

target_sources(app PRIVATE src/main.c)


# Custom files and folders

target_sources(app PRIVATE
    src/trailer_listener/trailer_listener.c
    src/ttl_central/ttl_central.c
)

zephyr_library_include_directories(include)
```

## prj.conf
```kconfig
# Configure logger
CONFIG_LOG=y
CONFIG_LOG_BACKEND_UART=y
# Enable debug logging
CONFIG_LOG_DEFAULT_LEVEL=4

# Configure gpio
CONFIG_GPIO=y

# Enable Bluetooth
CONFIG_BT=y
CONFIG_BT_CENTRAL=y
CONFIG_BT_DEBUG_LOG=y
CONFIG_BT_SMP=y
CONFIG_BT_GATT_CLIENT=y

# Enable Bluetooth multilink
CONFIG_BT_AUTO_PHY_UPDATE=n
CONFIG_BT_PRIVACY=y
CONFIG_BT_MAX_CONN=2

# Enable nrf scan utils (filter)
CONFIG_BT_SCAN=y
CONFIG_BT_SCAN_UUID_CNT=1
CONFIG_BT_SCAN_FILTER_ENABLE=y

# Enable nrf gatt discovery manager utils
CONFIG_BT_GATT_DM=y
CONFIG_BT_DEBUG_LOG=y
CONFIG_BT_GATT_DM_DATA_PRINT=y

# This example requires more workqueue stack and heap
CONFIG_HEAP_MEM_POOL_SIZE=2048
CONFIG_SYSTEM_WORKQUEUE_STACK_SIZE=2048

# Enable bonding
CONFIG_BT_SETTINGS=y
CONFIG_FLASH=y
CONFIG_FLASH_PAGE_LAYOUT=y
CONFIG_FLASH_MAP=y
CONFIG_NVS=y
CONFIG_SETTINGS=y
```

## src/main.c
```c
#include <zephyr.h>
#include <logging/log.h>
#include <inttypes.h>

#include "trailer_listener.h"
#include "ttl_central.h"

#define LOG_MODULE_NAME main
LOG_MODULE_REGISTER(LOG_MODULE_NAME);

#define GPIO_INTERRUPT 1

#define SLEEP_TIME_MS 100

static struct trailer_listener listener;
static uint8_t left_state = RUNNING;
static uint8_t right_state = RUNNING;

uint8_t map_listner_state(uint8_t *vals, uint8_t len, uint8_t *left_state, uint8_t *right_state)
{
    if (vals[BREAK])
    {
        *left_state = TTL_LIGHT_BREAK;
        *right_state = TTL_LIGHT_BREAK;
    }
    else if (vals[TURN_LEFT])
    {
        *left_state = TTL_LIGHT_TURN;
        *right_state = TTL_LIGHT_DRIVE;
    }
    else if (vals[TURN_RIGHT])
    {
        *left_state = TTL_LIGHT_DRIVE;
        *right_state = TTL_LIGHT_TURN;
    }
    else if (vals[REVERSE])
    {
        *left_state = TTL_LIGHT_REVERSE;
        *right_state = TTL_LIGHT_REVERSE;
    }
    else
    {
        *left_state = TTL_LIGHT_DRIVE;
        *right_state = TTL_LIGHT_DRIVE;
    }

    return 0;
}

void loop()
{
    int err = 0;
    uint8_t state = 0;

    while (1)
    {
        k_msleep(SLEEP_TIME_MS);
#ifndef GPIO_INTERRUPT
        err = trailer_listener_poll_state(&listener);
        if (err)
        {
            LOG_ERR("Failed to poll current trailer listener state");
            continue;
        }
#endif
        err = trailer_listener_get_state(&listener, &left_state, &right_state);
        if (err)
        {
            LOG_ERR("Failed to read trailer state, skip update");
            continue;
        }
        LOG_INF("Received map state: %d", state);

        err = ttl_right_sent_state(&right_state);
        if (err)
        {
            LOG_ERR("Failed to send updated state to right tuff tuff light");
            continue;
        }
        err = ttl_left_sent_state(&left_state);
        if (err)
        {
            LOG_ERR("Failed to send updated state to left tuff tuff light");
            continue;
        }
        LOG_INF("Send updated state %d to tuff tuff lights", state);
    }
}

void main()
{

    int err = 0;

    // create a new instance for the listner
    err = trailer_listener_init(&listener, map_listner_state);
    if (err)
    {
        LOG_ERR("Failed to initiated trailer listener, stop app");
        return;
    }
    LOG_INF("Initiated new trailer listener instance properly");

#ifdef GPIO_INTERRUPT
    err = trailer_listener_register_interrupt_cb(&listener);
    if (err)
    {
        LOG_ERR("Failed to initialize listner interrupts");
        return;
    }
#endif

    err = ttl_central_connect();
    if (err)
    {
        LOG_ERR("Failed to connect to right tuff tuff trailer light");
        return;
    }

    printk("Let's wait for ble connection");
    k_msleep(5000);

    loop();
}
```

## include/trailer_listener.h
```c
#ifndef TRAILER_LISTENER_H
#define TRAILER_LISTENER_H

#include <zephyr.h>
#include <device.h>
#include <drivers/gpio.h>
#include <inttypes.h>
#include <sys/util.h>
#include <stdio.h>
#include <string.h>

// helper macro to check if some value is null
#define CHECK_NULL(name, ret)                                                     \
    if (NULL == name)                                                             \
    {                                                                             \
        printk("Error: passed null name to trailer_listener_get_raw function\n"); \
        err = ret;                                                                \
        goto cleanup;                                                             \
    }

/*
 * Define how many values we will read and store later
 */
#define TRAILER_LISTENER_VALUES_LEN 5

/*
 * Define all the possible signals
 *  in addition, we will read them
 *  exactly within this order from the GPIO port
 */
enum GPIO_MAPPING
{
    REVERSE = 0,
    BREAK,
    TURN_LEFT,
    TURN_RIGHT,
    RUNNING
};

enum TTL_LIGHT_STATES
{
    TTL_LIGHT_REVERSE = 0,
    TTL_LIGHT_BREAK,
    TTL_LIGHT_TURN,
    TTL_LIGHT_DRIVE
};

struct trailer_listener
{
    uint8_t values[TRAILER_LISTENER_VALUES_LEN];
    uint8_t (*map_internal_state)(uint8_t *vals, uint8_t len, uint8_t *left_state, uint8_t *rigth_state);
    void (*interrupt_cb)(const struct device *dev, struct gpio_callback *cb, uint32_t pins);
};

/*
 * Init something
 */
int trailer_listener_init(struct trailer_listener *listener, uint8_t (*map_internal_state)(uint8_t *vals, uint8_t len, uint8_t *left_state, uint8_t *rigth_state));

/*
 * Register interrupt callbacks for gpio pins
 */
int trailer_listener_register_interrupt_cb(struct trailer_listener *listener);

/*
 * Internal and default callback for trailer listener gpio interrupts
 */
void _trailer_listener_gpio_cb(const struct device *dev, struct gpio_callback *cb, uint32_t pins);

/*
 * Read the state and store the result into the passed listener instance
 */
int trailer_listener_poll_state(struct trailer_listener *listener);

/*
 * Simply return the values which get fetched by the
 * trailer_listener_poll_state function
 * this function will copy the values
 */
int trailer_listener_get_raw(struct trailer_listener *listener, uint8_t *values);

/*
 * Map the values to an uint8_t state, logic is based via map_internal_state cb
 * if not define, return -1
 */
int trailer_listener_get_state(struct trailer_listener *listener, uint8_t *left_state, uint8_t *right_state);

#endif
```

## include/ttl_central.h
```c
#ifndef BLE_CENTRAL_H
#define BLE_CENTRAL_H

#include <zephyr.h>
#include <errno.h>
#include <sys/byteorder.h>

#include <bluetooth/bluetooth.h>
#include <bluetooth/hci.h>
#include <bluetooth/conn.h>
#include <bluetooth/uuid.h>
#include <bluetooth/gatt.h>

#include <bluetooth/services/nus.h>
#include <bluetooth/services/nus_client.h>
#include <bluetooth/gatt_dm.h>
#include <bluetooth/scan.h>

#include <settings/settings.h>
#include <logging/log.h>

/** @brief UUID of the Simple State Service. **/
#define BT_UUID_SSTATE_SERVICE_VAL \
    BT_UUID_128_ENCODE(0xe9ea0001, 0xe19b, 0x482d, 0x9293, 0xc7907585fc48)

/** @brief UUID of the Message Characteristic. **/
#define BT_UUID_SSTATE_CHANGE_CHRC_VAL \
    BT_UUID_128_ENCODE(0xe9ea0002, 0xe19b, 0x482d, 0x9293, 0xc7907585fc48)

#define BT_UUID_SSTATE_SERVICE BT_UUID_DECLARE_128(BT_UUID_SSTATE_SERVICE_VAL)
#define BT_UUID_SSTATE_CHANGE_CHRC BT_UUID_DECLARE_128(BT_UUID_SSTATE_CHANGE_CHRC_VAL)

// struct bt_gatt_write_params ttl_left_light_change_params;

int ttl_central_connect();

int ttl_right_sent_state(uint8_t *state);

int ttl_left_sent_state(uint8_t *state);

#endif
```
