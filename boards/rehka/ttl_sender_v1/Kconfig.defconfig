## boards/rehka/ttl_sender_v1/Kconfig.defconfig
```kconfig
# TTL Sender PA v1 board configuration

if BOARD_TTLPAV1

config BT_CTLR
	default BT

endif # BOARD_TTLPAV1
```

## boards/rehka/ttl_sender_v1/board.yml
```yaml
board:
  name: ttlpav1
  full_name: TTL Sender PA v1
  vendor: rehka
  socs:
  - name: nrf52840
```

## boards/rehka/ttlpav1/Kconfig.ttlpav1
```kconfig
# Copyright (c) 2022 Zephyr Project members and individual contributors
# SPDX-License-Identifier: Apache-2.0

config BOARD_TTLPAV1
	select SOC_NRF52840_QIAA if BOARD_TTLPAV1_NRF52840
```

## boards/rehka/ttlpav1/board.yml
```yaml
board:
  name: ttlpav1
  full_name: TTL nrf52840 fem module v1
  vendor: rehka
  socs:
  - name: nrf52840
```

## boards/rehka/ttlv1/Kconfig.defconfig
```kconfig
# TTL Sender PA v1 board configuration

if BOARD_TTLV1

config BT_CTLR
	default BT

endif # BOARD_TTLV1
```

## boards/rehka/ttlv1/Kconfig.ttlv1
```kconfig
# Copyright (c) 2022 Zephyr Project members and individual contributors
# SPDX-License-Identifier: Apache-2.0

config BOARD_TTLV1
	select SOC_NRF52840_QIAA if BOARD_TTLV1_NRF52840
```

## boards/rehka/ttlv1/board.yml
```yaml
board:
  name: ttlv1
  full_name: TTL nrf52840 module v1
  vendor: rehka
  socs:
  - name: nrf52840
```

## central/build/Kconfig/Kconfig.modules
```kconfig
menu "nrf (/home/akarner/ncs/nrf)"
osource "/home/akarner/ncs/nrf/Kconfig.nrf"
config ZEPHYR_NRF_MODULE
	bool
	default y
endmenu
menu "mcuboot (/home/akarner/ncs/bootloader/mcuboot)"
osource "$(ZEPHYR_MCUBOOT_KCONFIG)"
config ZEPHYR_MCUBOOT_MODULE
	bool
	default y
endmenu
menu "trusted-firmware-m (/home/akarner/ncs/modules/tee/tfm)"
osource "$(ZEPHYR_TRUSTED_FIRMWARE_M_KCONFIG)"
config ZEPHYR_TRUSTED_FIRMWARE_M_MODULE
	bool
	default y
endmenu
menu "cjson (/home/akarner/ncs/modules/lib/cjson)"
osource "$(ZEPHYR_CJSON_KCONFIG)"
config ZEPHYR_CJSON_MODULE
	bool
	default y
endmenu
menu "pelion-dm (/home/akarner/ncs/modules/lib/pelion-dm)"
osource "/home/akarner/ncs/modules/lib/pelion-dm/zephyr/Kconfig"
config ZEPHYR_PELION_DM_MODULE
	bool
	default y
endmenu
menu "cddl-gen (/home/akarner/ncs/modules/lib/cddl-gen)"
osource "$(ZEPHYR_CDDL_GEN_KCONFIG)"
config ZEPHYR_CDDL_GEN_MODULE
	bool
	default y
endmenu
menu "memfault-firmware-sdk (/home/akarner/ncs/modules/lib/memfault-firmware-sdk)"
osource "/home/akarner/ncs/modules/lib/memfault-firmware-sdk/ports/zephyr/Kconfig"
config ZEPHYR_MEMFAULT_FIRMWARE_SDK_MODULE
	bool
	default y
endmenu
menu "CANopenNode (/home/akarner/ncs/modules/lib/canopennode)"
osource "$(ZEPHYR_CANOPENNODE_KCONFIG)"
config ZEPHYR_CANOPENNODE_MODULE
	bool
	default y
endmenu
menu "hal_nordic (/home/akarner/ncs/modules/hal/nordic)"
osource "$(ZEPHYR_HAL_NORDIC_KCONFIG)"
config ZEPHYR_HAL_NORDIC_MODULE
	bool
	default y
endmenu
menu "loramac-node (/home/akarner/ncs/modules/lib/loramac-node)"
osource "$(ZEPHYR_LORAMAC_NODE_KCONFIG)"
config ZEPHYR_LORAMAC_NODE_MODULE
	bool
	default y
endmenu
menu "lz4 (/home/akarner/ncs/modules/lib/lz4)"
osource "$(ZEPHYR_LZ4_KCONFIG)"
config ZEPHYR_LZ4_MODULE
	bool
	default y
endmenu
menu "mbedtls (/home/akarner/ncs/modules/crypto/mbedtls)"
osource "$(ZEPHYR_MBEDTLS_KCONFIG)"
config ZEPHYR_MBEDTLS_MODULE
	bool
	default y
endmenu
menu "nanopb (/home/akarner/ncs/modules/lib/nanopb)"
osource "$(ZEPHYR_NANOPB_KCONFIG)"
config ZEPHYR_NANOPB_MODULE
	bool
	default y
endmenu
menu "TraceRecorder (/home/akarner/ncs/modules/debug/TraceRecorder)"
osource "/home/akarner/ncs/modules/debug/TraceRecorder/kernelports/Zephyr/Kconfig"
config ZEPHYR_TRACERECORDER_MODULE
	bool
	default y
endmenu
menu "nrfxlib (/home/akarner/ncs/nrfxlib)"
osource "/home/akarner/ncs/nrfxlib/Kconfig.nrfxlib"
config ZEPHYR_NRFXLIB_MODULE
	bool
	default y
endmenu
menu "connectedhomeip (/home/akarner/ncs/modules/lib/matter)"
osource "/home/akarner/ncs/modules/lib/matter/config/nrfconnect/chip-module/Kconfig"
config ZEPHYR_CONNECTEDHOMEIP_MODULE
	bool
	default y
endmenu
```

## west.yml
```yaml
# Tuff-Tuff-Light (TTL) West manifest repository
# Copyright (c) 2025 Rehka.dev

manifest:
  # use the latest version of the manifest format
  version: 1.2

  self:
    path: ttl

  remotes:
    - name: zephyrproject-rtos
      url-base: https://github.com/zephyrproject-rtos
    - name: nrfconnect
      url-base: https://github.com/nrfconnect

  # Projects to manage with west
  projects:
    # ttl is based on the nrf sdk (based on nordic mcus)
    - name: sdk-nrf
      path: nrf
      remote: nrfconnect
      revision: v2.9.0
      import: true
```
