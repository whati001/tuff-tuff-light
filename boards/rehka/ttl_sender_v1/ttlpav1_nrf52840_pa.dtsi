/**
 * Configure FEM for nrf52840 radio as stated in dts/bindings/net/wireless/nordic,nrf-radio.yaml
 * It is important that the nodelabel is `nrf_radio_fem`, see:
 *  - https://docs.nordicsemi.com/bundle/ncs-latest/page/nrf/app_dev/device_guides/fem/fem_software_support.html
 *  - https://docs.nordicsemi.com/bundle/ncs-latest/page/nrf/app_dev/device_guides/fem/fem_simple_gpio.html
 */
/ {
  nrf_radio_fem: fem {
    compatible = "skyworks,sky66112-11", "generic-fem-two-ctrl-pins";
    ctx-gpios = <&gpio1 2 GPIO_ACTIVE_HIGH>;
    crx-gpios = <&gpio1 4 GPIO_ACTIVE_HIGH>;

    tx-gain-db = <3>; // provides the best performance, guess this implies 3V
    rx-gain-db = <3>;
  };
};

&radio {
  fem = <&nrf_radio_fem>;
};